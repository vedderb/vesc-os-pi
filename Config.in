## Config.in
```kconfig
source "$BR2_EXTERNAL_VESC_OS_PATH/package/qt5gamepad/Config.in"
source "$BR2_EXTERNAL_VESC_OS_PATH/package/vesc-tool/Config.in"
```

## configs/vesc_rpi3_defconfig
```kconfig
BR2_TARGET_GENERIC_ISSUE="Welcome to VESC Tool OS"
BR2_ROOTFS_OVERLAY="$(BR2_EXTERNAL_VESC_OS_PATH)/rootfs-overlay/qmlui"

# Raspberry Pi version-specific
BR2_arm=y
BR2_cortex_a53=y
BR2_ARM_FPU_NEON_VFPV4=y
BR2_PACKAGE_HOST_LINUX_HEADERS_CUSTOM_5_10=y
BR2_ROOTFS_POST_BUILD_SCRIPT="board/raspberrypi3/post-build.sh"
BR2_ROOTFS_POST_IMAGE_SCRIPT="$(BR2_EXTERNAL_VESC_OS_PATH)/scripts/config.sh board/raspberrypi3/post-image.sh"
BR2_LINUX_KERNEL_CUSTOM_TARBALL=y
BR2_LINUX_KERNEL_CUSTOM_TARBALL_LOCATION="$(call github,raspberrypi,linux,9878a118cbdb7779fd15caa45915d22bff381ba3)/linux-9878a118cbdb7779fd15caa45915d22bff381ba3.tar.gz"
BR2_LINUX_KERNEL_DEFCONFIG="bcm2709"
BR2_LINUX_KERNEL_INTREE_DTS_NAME="bcm2710-rpi-3-b bcm2710-rpi-3-b-plus bcm2710-rpi-cm3"

BR2_PACKAGE_RPI_FIRMWARE=y
BR2_PACKAGE_RPI_FIRMWARE_BOOTCODE_BIN=y
BR2_PACKAGE_RPI_FIRMWARE_VARIANT_PI=y
BR2_PACKAGE_RPI_FIRMWARE_CONFIG_FILE="board/raspberrypi3/config_3.txt"

BR2_LINUX_KERNEL=y
BR2_LINUX_KERNEL_DTS_SUPPORT=y
BR2_LINUX_KERNEL_NEEDS_HOST_OPENSSL=y
BR2_PACKAGE_HOST_DOSFSTOOLS=y
BR2_PACKAGE_HOST_GENIMAGE=y
BR2_PACKAGE_HOST_MTOOLS=y

# For boot screen
BR2_PACKAGE_FBV=y
BR2_PACKAGE_FBV_PNG=y
BR2_PACKAGE_FBV_JPEG=y

BR2_TOOLCHAIN_BUILDROOT_WCHAR=y
BR2_TOOLCHAIN_BUILDROOT_CXX=y
BR2_ROOTFS_DEVICE_CREATION_DYNAMIC_EUDEV=y

BR2_PACKAGE_BLUEZ5_UTILS=y
BR2_PACKAGE_SDL2=y
BR2_PACKAGE_SDL2_OPENGLES=y
BR2_PACKAGE_LIBPNG=y
BR2_PACKAGE_LIBSVG=y
BR2_PACKAGE_JPEG=y

# GPU
BR2_PACKAGE_RPI_USERLAND=y
BR2_PACKAGE_HAS_LIBGLES=y

# Qt
BR2_PACKAGE_QT5=y
BR2_PACKAGE_QT5BASE=y
BR2_PACKAGE_QT5BASE_GUI=y
BR2_PACKAGE_QT5BASE_WIDGETS=y
BR2_PACKAGE_QT5BASE_HARFBUZZ=y
BR2_PACKAGE_QT5BASE_PRINTSUPPORT=y
BR2_PACKAGE_QT5BASE_ICU=y
BR2_PACKAGE_QT5BASE_TSLIB=y
BR2_PACKAGE_QT5BASE_PNG=y
BR2_PACKAGE_QT5BASE_JPEG=y
BR2_PACKAGE_QT5BASE_EGLFS=y
BR2_PACKAGE_QT53D=y
BR2_PACKAGE_QT5CONNECTIVITY=y
BR2_PACKAGE_QT5LOCATION=y
BR2_PACKAGE_QT5QUICKCONTROLS=y
BR2_PACKAGE_QT5QUICKCONTROLS2=y
BR2_PACKAGE_QT5SERIALPORT=y
BR2_PACKAGE_QT5SVG=y
BR2_PACKAGE_QT5GRAPHICALEFFECTS=y
BR2_PACKAGE_QT5DECLARATIVE=y

BR2_PACKAGE_QT5GAMEPAD=y
BR2_PACKAGE_VESC_TOOL=y

# File system
BR2_TARGET_ROOTFS_EXT2=y
BR2_TARGET_ROOTFS_EXT2_4=y
BR2_TARGET_ROOTFS_EXT2_SIZE="450M"
BR2_TARGET_GENERIC_REMOUNT_ROOTFS_RW=n
```

## package/qt5gamepad/Config.in
```kconfig
config BR2_PACKAGE_QT5GAMEPAD
	bool "qt5gamepad"
	help
	  Qt is a cross-platform application and UI framework for
	  developers using C++.

	  This package corresponds to the qt5gamepad module.

	  https://doc.qt.io/qt-5/qtgamepad-index.html
```

## package/vesc-tool/Config.in
```kconfig
config BR2_PACKAGE_VESC_TOOL
	bool "vesc-tool"
	depends on BR2_PACKAGE_QT5
	depends on BR2_PACKAGE_QT5BASE
	depends on BR2_PACKAGE_QT5SERIALPORT
	depends on BR2_PACKAGE_QT5QUICKCONTROLS
	depends on BR2_PACKAGE_QT5QUICKCONTROLS2
	depends on BR2_PACKAGE_QT5CONNECTIVITY
	depends on BR2_PACKAGE_QT53D
	depends on BR2_PACKAGE_QT5DECLARATIVE
	depends on BR2_PACKAGE_QT5SVG
	depends on BR2_PACKAGE_QT5LOCATION
	depends on BR2_PACKAGE_QT5GAMEPAD
	help
	  Vesc tool

	  https://github.com/vedderb/vesc_tool/
```
